// SPDX-License-Identifier: GPL-2.0-only
/*
 * Test overlay, variant=1: the AVE node only - NO DART node, NO "iommus".
 *
 * apple-dart therefore never binds to the AVE DART, so it never resets it.
 * The idea was to keep whatever configuration iBoot left in the DART.
 *
 * Status: almost certainly pointless, and not run. On a fresh boot venc_sys -
 * the DART's power domain - is already off before this overlay could load, so
 * iBoot's DART state is gone either way. See docs/41 "Where that leaves the two
 * modes". Kept only in case DART state is ever shown to survive power gating.
 *
 * It also removes the backstop: a stray coprocessor write lands in physical
 * RAM instead of raising a DART fault.
 *
 * Sentinel phandles 0xa7e000NN (the base tree has no __symbols__), which
 * ave_overlay_mod.c replaces at load time with the live phandles (docs/79
 * §3). NN is the stock t6001 phandle; what it pointed at there is what the
 * module looks up (earlier comments here named 0xc2-0xc5 dma/pipe4/pipe5/me0,
 * which the stock DT does not bear out):
 *   0x13  the AIC (compatible)   0x1d  venc_sys (label; also resets)
 *   0xc2  venc_pipe5             0xc4  venc_me0
 *   0xc3  venc_pipe4             0xc5  afnc4_ioa
 *
 * All five referenceable domains are listed rather than relying on genpd to
 * pull ancestors up. venc_me1 has no phandle in the base tree so cannot be
 * referenced from an overlay; its parent venc_me0 is the deepest we can reach.
 *
 * Compile WITHOUT -@: that flag emits a __symbols__ node the live tree lacks,
 * and the overlay is then rejected with -EINVAL.
 */
/dts-v1/;
/plugin/;

/ {
	fragment@0 {
		target-path = "/soc";

		__overlay__ {
			#address-cells = <2>;
			#size-cells = <2>;

			ave0: video-encoder@40d100000 {
				compatible = "apple,t6001-ave", "apple,ave";
				/* CPU physical = ADT bus + 0x2_00000000, per
				 * /arm-io "ranges". See tools/check_addrs.py. */
				reg = <0x4 0x0d100000 0x0 0x45c000>,
				      <0x4 0x0d800000 0x0 0x800000>,
				      <0x4 0x0d050000 0x0 0x008000>,
				      <0x2 0x8e588000 0x0 0x000024>,
				      <0x4 0x0c000000 0x0 0x1000000>;
				reg-names = "dpe", "asc", "sve", "unk3", "axi2af";
				interrupt-parent = <0xa7e00013>;
				interrupts = <0 0 1031 4>;
				power-domains = <0xa7e0001d>, <0xa7e000c2>, <0xa7e000c4>,
						<0xa7e000c3>, <0xa7e000c5>;
				/* apple-avd does reset_control_reset() before its
				 * first register access; #reset-cells is 0 */
				resets = <0xa7e0001d>;
				/*
				 * No "iommus" on purpose, and no DART nodes
				 * above. apple-dart therefore never binds to
				 * the AVE DART, and iBoot's configuration of
				 * it survives - which is the whole point of
				 * this variant.
				 *
				 * The cost is real: the device has NO IOMMU
				 * backstop. Every previous experiment had the
				 * DART catching stray accesses as loud
				 * translation faults; here a stray write from
				 * the coprocessor lands in physical RAM. We
				 * would also be running iBoot's firmware
				 * image, whose addressing assumptions we have
				 * not read.
				 */
			};
		};
	};
};
