// SPDX-License-Identifier: GPL-2.0-only
/*
 * Test overlay: adds the ave0 encoder and its DART to a running t6001.
 *
 * The base device tree has neither, because m1n1 emits nodes only for blocks
 * with an existing binding. Phandles are written as literals because the base
 * DT carries no __symbols__ for us to reference by name:
 *
 *   0x13  aic
 *   0x1d  ps_venc_sys
 *   0xc4  ps_venc_pipe4
 *   0xc5  ps_venc_me0
 *
 * This is a BRING-UP AID, not a proposed binding. It deliberately omits the
 * firmware: the runtime ADT's segment-ranges for AVE are not exposed to Linux,
 * so probe is expected to fail at ave_fw_adopt(). Everything before that point
 * - bank mapping, DMA/DART attachment, interrupt request, power domains - is
 * what this exercises.
 */
/dts-v1/;
/plugin/;

/ {
	fragment@0 {
		target-path = "/soc";

		__overlay__ {
			#address-cells = <2>;
			#size-cells = <2>;

			dart_ave0: iommu@20d040000 {
				compatible = "apple,t6000-dart";
				reg = <0x2 0x0d040000 0x0 0x4000>,
				      <0x2 0x0d030000 0x0 0x4000>,
				      <0x2 0x0d020000 0x0 0x4000>,
				      <0x2 0x0d044000 0x0 0x4000>;
				interrupt-parent = <0x13>;
				interrupts = <0 0 1028 4>;
				#iommu-cells = <1>;
				power-domains = <0x1d>;
			};

			ave0: video-encoder@20d100000 {
				compatible = "apple,t6001-ave", "apple,ave";
				reg = <0x2 0x0d100000 0x0 0x45c000>,
				      <0x2 0x0d800000 0x0 0x800000>,
				      <0x2 0x0d050000 0x0 0x008000>,
				      <0x0 0x8e588000 0x0 0x000024>,
				      <0x2 0x0c000000 0x0 0x1000000>;
				reg-names = "dpe", "asc", "sve", "unk3", "axi2af";
				interrupt-parent = <0x13>;
				interrupts = <0 0 1031 4>;
				iommus = <&dart_ave0 0>;
				power-domains = <0xc4>, <0xc5>;
			};
		};
	};
};
