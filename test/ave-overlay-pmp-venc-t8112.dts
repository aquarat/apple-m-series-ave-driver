// SPDX-License-Identifier: GPL-2.0-only
/*
 * t8112 (docs/90 §9): the same entry is report@9 under pmp_report@23b3c0000.
 *
 * docs/75 R3, docs/78: enable the PMP's report entry for VENC_SYS. Its genpd
 * is a subdomain of ps_venc_sys; powering it sets the PS-REQ bit for VENC and
 * waits for the PMP's ACK, and powering it off clears the bit first. The
 * driver holds it with pmp_report=1. Only meaningful on a DT built with
 * APPLE_USE_PMP, where the PMP runs. Applied by ave-overlay pmp_venc=1.
 */
/dts-v1/;
/plugin/;

/ {
	fragment@0 {
		target-path = "/soc/pmp_report@23b3c0000/report@9";

		__overlay__ {
			status = "okay";
		};
	};
};
