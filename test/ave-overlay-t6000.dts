// SPDX-License-Identifier: GPL-2.0-only
/*
 * variant=8 (docs/87): t6000 (M1 Pro, j314s/j316s), ave0. variant=4's node
 * and DARTs with two changes, both from the j314s ADT and the live t6000 DT:
 *
 *   - compatible "apple,t6000-ave", which selects the driver's t6000 row
 *     (H13S firmware placement, driver-programmed DAPF);
 *   - no afnc4_ioa (sentinel 0xc5) in power-domains. It is a t6001-only
 *     fabric domain (the t6000 DT has afnc0-3 only), and not one of the
 *     ADT ave0's power-gates on either SoC (docs/57 §3.3, docs/79 §3).
 *
 * Everything else - reg, interrupts, the two DART instances, stream IDs -
 * is t6001's: the j314s and j314c ADTs agree on /arm-io/ave0 and
 * /arm-io/dart-ave0. See ave-overlay-e4.dts for why each entry is there.
 * Sentinel phandles as in variant=4; compile WITHOUT -@.
 */
/dts-v1/;
/plugin/;

/ {
	fragment@0 {
		target-path = "/soc";

		__overlay__ {
			#address-cells = <2>;
			#size-cells = <2>;

			/*
			 * ADT dart-ave0 has four reg ranges but only TWO are
			 * DARTs. The ADT "instance" property decodes to
			 * DAPF:CPUDART, DART:DART, SMMU:SMMU, and the layout is
			 * DARTs first, then SMMUs, then one DAPF at
			 * first-DART+0x4000:
			 *
			 *   reg[0] 0x40d040000  CPUDART  (DART)
			 *   reg[1] 0x40d030000  DART     (DART)
			 *   reg[2] 0x40d020000  SMMU     - NOT a DART
			 *   reg[3] 0x40d044000  DAPF     - NOT a DART
			 *
			 * ADT dart-isp0 confirms the rule: five entries over
			 * six regs, and Linux models exactly reg[0..2].
			 * Pointing apple-dart at the SMMU or the DAPF makes it
			 * write DART register layouts into blocks that are not
			 * DARTs.
			 *
			 * Both DARTs share ONE interrupt (1028). Linux models multi-instance DARTs
			 * as separate single-reg nodes that all carry the same
			 * shared interrupt - ADT dart-isp0 has six instances on
			 * interrupt 543, and Linux's iommu@3860e8000,
			 * @3860f4000 and @3860fc000 each declare 0x21f.
			 *
			 * Modelling only instance 0 caused an interrupt storm:
			 * apple-dart initialised and unmasked instance 0, the
			 * other three kept the shared line asserted with
			 * nothing able to clear them, every IRQ returned
			 * IRQ_NONE, and the kernel force-disabled IRQ 130.
			 * All four instances must be present.
			 */
			dart_ave0_0: iommu@40d040000 {
				compatible = "apple,t6000-dart";
				reg = <0x4 0x0d040000 0x0 0x4000>;
				interrupt-parent = <0xa7e00013>;
				interrupts = <0 0 1028 4>;
				#iommu-cells = <1>;
				power-domains = <0xa7e0001d>;
			};

			dart_ave0_1: iommu@40d030000 {
				compatible = "apple,t6000-dart";
				reg = <0x4 0x0d030000 0x0 0x4000>;
				interrupt-parent = <0xa7e00013>;
				interrupts = <0 0 1028 4>;
				#iommu-cells = <1>;
				power-domains = <0xa7e0001d>;
			};

			ave0: video-encoder@40d100000 {
				compatible = "apple,t6000-ave", "apple,ave";
				/* CPU physical = ADT bus + 0x2_00000000, per
				 * /arm-io "ranges". See tools/check_addrs.py. */
				reg = <0x4 0x0d100000 0x0 0x45c000>,
				      <0x4 0x0d800000 0x0 0x800000>,
				      <0x4 0x0d050000 0x0 0x008000>,
				      <0x2 0x8e588000 0x0 0x000024>,
				      <0x4 0x0c000000 0x0 0x1000000>,
				      <0x4 0x0d040000 0x0 0x4000>,
				      <0x4 0x0d044000 0x0 0x4000>,
				      <0x4 0x0d020000 0x0 0x4000>;
				reg-names = "dpe", "asc", "sve", "unk3", "axi2af",
					    "cpudart", "dapf", "smmu";
				interrupt-parent = <0xa7e00013>;
				/*
				 * [1] is AIC 1028, the line the two DART nodes and
				 * the unmodelled SMMU share. Only ave_smmu.c
				 * requests it (IRQF_SHARED, read-only), and only
				 * with smmu_watch=1. docs/56 Q3.
				 */
				interrupts = <0 0 1031 4>, <0 0 1028 4>;
				power-domains = <0xa7e0001d>, <0xa7e000c2>, <0xa7e000c4>,
						<0xa7e000c3>;
				/* apple-avd does reset_control_reset() before its
				 * first register access; #reset-cells is 0 */
				resets = <0xa7e0001d>;
				/*
				 * variant=4: BOTH DART instances, like Linux's ISP
				 * node (iommus = <&dart_isp0 0>, <&dart_isp1 0>,
				 * <&dart_isp2 0>), so one translating domain maps
				 * every buffer into both.
				 *
				 * variant=3 attached only 40d040000, the CPUDART the
				 * ASC core fetches through. That was right for the
				 * firmware's CPU, but the first Process
				 * (results/f3-1789384805.kmsg) started the encoder
				 * hardware, whose bus-master DMA then reported AXI
				 * errors and hung: its addresses were mapped in
				 * nobody's tables but the CPU's (docs/56).
				 *
				 * The reason variant=3 was single-DART no longer
				 * applies: that was an identity domain, which needs
				 * bypass on every DART in the group, and 40d030000
				 * has none. This is a translating domain.
				 */
				/*
				 * SID 1 as well: macOS folds stream 1 onto SID 0
				 * with the remap register (+0x80, ADT remap = 1),
				 * which apple-dart never writes. Translating SID 1
				 * with the same domain is equivalent and harmless
				 * if unused. docs/56 Q1.
				 */
				iommus = <&dart_ave0_0 0>, <&dart_ave0_0 1>,
					 <&dart_ave0_1 0>, <&dart_ave0_1 1>;
			};
		};
	};
};
